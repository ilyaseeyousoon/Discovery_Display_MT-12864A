
#include <stm32f10x_conf.h>
#include <stm32f10x_usart.h>
#include <stm32f10x_rcc.h>
#include <stm32f10x_gpio.h>
#include "stm32f10x_adc.h"
#include "stm32f10x_spi.h"


// Пауза
uint32_t logo[16][64] =
{
	{0,0,0,0,0,0,0,0,0,0,0,0,0,0,0,0,0,0,0,0,0,0,0,0,0,0,0,0,0,0,0,0,0,0,0,0,0,0,0,0,0,0,0,0,0,0,0,0,0,0,0,0,0,0,0,0,0,0,0,0,0,0,0,0},
	{0,0,0,0,0,0,0,0,0,0,0,0,0,0,0,0,0,0,0,0,0,0,0,0,0,0,0,0,0,0,0,0,0,0,0,0,0,0,0,0,0,0,0,0,0,0,0,0,0,0,0,0,0,0,0,0,0,0,0,0,0,0,0,0},
	{0,0,0,0,0,0,0,0,0,225,225,0,0,0,0,0,0,0,0,0,0,0,0,0,0,0,0,0,0,0,0,0,0,0,0,0,0,0,0,0,0,0,0,0,0,0,0,0,0,0,0,0,0,0,0,0,0,0,0,0,0,0,0,0},
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	{0,0,0,0,0,0,0,0,0,0,0,0,0,0,0,0,0,0,0,0,0,0,0,0,0,0,0,0,0,0,0,0,0,0,0,0,0,0,0,0,0,0,0,0,0,0,0,0,0,0,0,0,0,0,0,0,0,0,0,0,0,0,0,0}
};
void Delay(volatile uint32_t nCount) {
    for (; nCount != 0; nCount--);
}

// Запись байта в ЖК

void LcdByte(uint32_t byte)
{
	GPIOC->ODR = byte;	   	// Вывод в порт
	Delay(0x000F);		   	// Пауза 1 мкс
	GPIOC->BSRR = GPIO_BSRR_BS9;    // Выставляем Е
	Delay(0x000F);		   	// Пауза 1 мкс
	GPIOC->BSRR = GPIO_BSRR_BR9;	// Сбрасываем Е
	Delay(0x000F);		   	// Пауза 1 мкс
}

void CodeL(uint32_t code)
{
	code |= 0x0900;    // Побитное ИЛИ кода с командой в левый кристалл
	LcdByte(code);
}

void CodeR(uint32_t code)
{
	code |= 0x1100;    // Побитное ИЛИ кода с командой в правый кристалл
	LcdByte(code);
}

void DataL(uint32_t code)
{
	code |= 0x2900;    // Побитное ИЛИ данных с командой в левый кристалл
 	LcdByte(code);
}

void DataR(uint32_t code)
{
	code |= 0x3100;    // Побитное ИЛИ данных с командой в правый кристалл
	LcdByte(code);
}


int main(void)
{
	uint32_t i, j, k;

	RCC->APB2ENR |= RCC_APB2ENR_IOPCEN; // Разрешить тактирование PORTC
	GPIOC->CRL = GPIO_CRL_MODE;
	GPIOC->CRH = GPIO_CRH_MODE;

	GPIO_SetBits( GPIOC,  GPIO_Pin_9);
	Delay(0x1E);
	GPIO_ResetBits( GPIOC,  GPIO_Pin_9);
	Delay(0xFF);
	CodeL(0x3F);
	CodeR(0x3F);
	CodeL(0xB8);
	CodeL(0x40);
	CodeR(0xB8);
	CodeR(0x40);
	Delay(0x1E);
	Delay(0x1E);
		GPIOC->BSRR = GPIO_BSRR_BR12;
		Delay(0x000F);
GPIOC->BSRR = GPIO_BSRR_BS9;    // Выставляем Е
	Delay(0x000F);		   	// Пауза 1 мкс
	GPIOC->BSRR = GPIO_BSRR_BR9;	// Сбрасываем Е
	Delay(0x000F);		   	// Пауза 1 мкс
	i = 0x00;
	j = 0x00;
	while(i<0x08)
	{
			k = 0x00;
//			CodeL(0x40);
			while(k<0x40)
			{
				DataL(logo[j][k]);
				k++;
			}
			k = 0x00;
			j++;
			CodeR(0x40);
			while(k<0x40)
			{
				DataR(logo[j][k]);
				k++;
			}
		i++;
		j++;
		CodeL(0xB8 + i);
		CodeR(0xB8 + i);
	}
GLCD_Rectangle(1, 2, 3, 4);
	return 0;
}
